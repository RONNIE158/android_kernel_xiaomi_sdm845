## drivers/gpu/drm/virt_drm_fb/Kconfig
```kconfig
config DRM_VIRT_FB
    tristate "Virtual DRM framebuffer for headless / VNC Android"
    default y
    help
      A virtual DRM framebuffer device that can be updated from
      SurfaceFlinger/HWC and exposed to userspace for VNC/headless display.
config VIRT_VNC_DAEMON
    tristate "Virtual VNC Daemon for headless / fb1"
    default y
    help
      Userspace-like kernel module (as simple daemon) to export
      /dev/fb1 to VNC clients for headless Android display.
```

## drivers/gpu/kgsl-vnc/Kconfig
```kconfig
config KGSL_VNC_DISPLAY
    tristate "KGSL VNC Display Streamer"
    depends on MSM_KGSL_DRM && NET
    default y
    help
      Stream framebuffer via TCP (VNC placeholder).
      Say Y to compile into the kernel, M to build as module, N to disable.
```

## drivers/video/Kconfig
```kconfig
#
# Video configuration
#

menu "Graphics support"
	depends on HAS_IOMEM

menuconfig FB_VIRTUAL
    bool "Virtual Framebuffer"
    default y
    help
      Minimal virtual framebuffer for headless Android.
      Can be built-in (y) or module (m).

config HAVE_FB_ATMEL
	bool

config SH_LCD_MIPI_DSI
	bool

source "drivers/video/fb_virtual/Kconfig"

source "drivers/char/agp/Kconfig"

source "drivers/gpu/vga/Kconfig"

source "drivers/gpu/host1x/Kconfig"
source "drivers/gpu/ipu-v3/Kconfig"
source "drivers/gpu/msm/Kconfig"

source "drivers/gpu/drm/Kconfig"

menu "Frame buffer Devices"
source "drivers/video/fbdev/Kconfig"
endmenu

source "drivers/video/backlight/Kconfig"
source "drivers/video/adf/Kconfig"

config VGASTATE
       tristate
       default n

config VIDEOMODE_HELPERS
	bool

config HDMI
	bool

if VT
	source "drivers/video/console/Kconfig"
endif

if FB || SGI_NEWPORT_CONSOLE
	source "drivers/video/logo/Kconfig"

endif


endmenu
```

## drivers/video/virt_fb/Kconfig
```kconfig
config VIRT_FB
    tristate "Virtual framebuffer for headless / VNC"
    default y
    help
      Provides a secondary framebuffer (/dev/fb1) which can be updated
      from userspace daemon or HWC/SurfaceFlinger for VNC streaming.
```
